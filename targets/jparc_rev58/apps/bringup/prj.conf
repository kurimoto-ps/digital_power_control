## CMakeLists.txt
```
# SPDX-License-Identifier: Apache-2.0
cmake_minimum_required(VERSION 3.20.0)
get_filename_component(REV58_ROOT "${CMAKE_CURRENT_SOURCE_DIR}/../.." ABSOLUTE)
list(APPEND BOARD_ROOT "${REV58_ROOT}")
list(APPEND DTS_ROOT "${REV58_ROOT}")
find_package(Zephyr REQUIRED HINTS $ENV{ZEPHYR_BASE})
project(jparc_rev58_bringup)
if(NOT CONFIG_BOARD_JPARC_REV58)
  message(FATAL_ERROR "This bring-up application requires jparc_rev58")
endif()
target_sources(app PRIVATE src/main.c src/peripheral_checks.c)

if(CONFIG_JPARC_SPI4_REGS_TEST)
  target_sources(app PRIVATE src/spi4_test_server.c
    ${REV58_ROOT}/lib/fpga_link/spi4_protocol.c)
  target_include_directories(app PRIVATE ${REV58_ROOT}/lib/fpga_link)
endif()

if(CONFIG_JPARC_ADC_DUMMY_TEST)
  target_sources(app PRIVATE src/adc_dummy_test.c ${REV58_ROOT}/lib/fpga_link/adc_stream.c)
endif()

if(CONFIG_JPARC_MIXED_ADC_TEST)
  target_sources(app PRIVATE src/mixed_adc_test.c ${REV58_ROOT}/lib/fpga_link/mixed_stream.c)
endif()

if(CONFIG_JPARC_BOARD_IO_TEST)
  target_sources(app PRIVATE src/board_io_test.c ${REV58_ROOT}/lib/plc/board_io_protocol.c
    ${REV58_ROOT}/lib/fpga_link/acc_monitor.c)
  target_include_directories(app PRIVATE ${REV58_ROOT}/lib/plc)
endif()
```

## Kconfig
```
mainmenu "J-PARC rev58 bring-up"
source "Kconfig.zephyr"

config JPARC_SPI4_REGS_TEST
    bool "Ethernet to MAX10 SPI4 register test"
    depends on NETWORKING && NET_TCP && NET_SOCKETS && SPI

config JPARC_SPI4_TEST_IP
    string "Static test IPv4 address"
    default "192.168.100.58"
    depends on JPARC_SPI4_REGS_TEST

config JPARC_SPI4_TEST_PORT
    int "TCP test port"
    range 1024 65535
    default 4244
    depends on JPARC_SPI4_REGS_TEST

config JPARC_ADC_DUMMY_TEST
    bool "SPI1 continuous DMA dummy ADC test"
    depends on JPARC_SPI4_REGS_TEST && DMA && SPI_SLAVE

config JPARC_MIXED_ADC_TEST
    bool "FPGA v2 48-byte continuous DMA capture"
    depends on JPARC_SPI4_REGS_TEST && DMA && SPI_SLAVE && !JPARC_ADC_DUMMY_TEST

config JPARC_BOARD_IO_TEST
    bool "PLC GPIO and motherboard UART mapping tests"
    depends on JPARC_SPI4_REGS_TEST && GPIO && SERIAL && UART_INTERRUPT_DRIVEN
```

## prj.conf
```kconfig
# SPDX-License-Identifier: Apache-2.0
CONFIG_CONSOLE=y
CONFIG_PRINTK=y
CONFIG_USE_SEGGER_RTT=y
CONFIG_RTT_CONSOLE=y
CONFIG_UART_CONSOLE=n
CONFIG_SERIAL=n
CONFIG_MAIN_STACK_SIZE=2048
CONFIG_ASSERT=y
CONFIG_BOOT_BANNER=y
# Make debugger/RTT status and destructive SDRAM checks visible in physical RAM.
CONFIG_DCACHE=n
```

## src/main.c
```c
/* SPDX-License-Identifier: Apache-2.0 */
#include <zephyr/kernel.h>
#include <zephyr/drivers/gpio.h>
#include <zephyr/sys/printk.h>
#include <soc.h>
#include <stm32_ll_bus.h>
#include <stm32_ll_pwr.h>
#include "peripheral_checks.h"
#ifdef CONFIG_JPARC_SPI4_REGS_TEST
#include "spi4_test_server.h"
#endif

/* Read from GDB even when no RTT client is connected. Raw register snapshots. */
struct bringup_status {
    uint32_t magic;
    uint32_t ticks;
    uint32_t sysclk_hz;
    uint32_t hclk_hz;
    uint32_t pwr_cr3;
    uint32_t pwr_d3cr;
    uint32_t syscfg_pwrcr;
    uint32_t syscfg_ur1;
    int error;
    int ready_raw;
    int fault_raw;
    int irq_raw;
};
volatile struct bringup_status rev58_status;
#define IO DT_PATH(zephyr_user)
static const struct gpio_dt_spec inputs[] = {
    GPIO_DT_SPEC_GET(IO, ready_gpios),
    GPIO_DT_SPEC_GET(IO, fault_gpios),
    GPIO_DT_SPEC_GET(IO, irq_gpios),
};

int main(void)
{
    LL_APB4_GRP1_EnableClock(LL_APB4_GRP1_PERIPH_SYSCFG);
    rev58_status.magic = 0x52563538; /* RV58 */
    rev58_status.sysclk_hz = HAL_RCC_GetSysClockFreq();
    rev58_status.hclk_hz = HAL_RCC_GetHCLKFreq();
    rev58_status.pwr_cr3 = PWR->CR3;
    rev58_status.pwr_d3cr = PWR->D3CR;
    rev58_status.syscfg_pwrcr = SYSCFG->PWRCR;
    rev58_status.syscfg_ur1 = SYSCFG->UR1;
    printk("J-PARC rev58 M7 bring-up: SYSCLK=%u HCLK=%u\n",
           rev58_status.sysclk_hz, rev58_status.hclk_hz);
    /* BCM4 must be cleared before boot: do not change persistent option bytes here. */
    if (rev58_status.sysclk_hz != 400000000 || rev58_status.hclk_hz != 200000000 ||
        (PWR->CR3 & (PWR_CR3_SMPSEN | PWR_CR3_LDOEN | PWR_CR3_BYPASS)) != PWR_CR3_SMPSEN ||
        (PWR->D3CR & PWR_D3CR_VOS) != LL_PWR_REGU_VOLTAGE_SCALE1 ||
        (SYSCFG->PWRCR & SYSCFG_PWRCR_ODEN) || (SYSCFG->UR1 & SYSCFG_UR1_BCM4)) {
        rev58_status.error = -EINVAL;
        printk("Clock/power/BCM4 mismatch: inspect rev58_status with debugger\n");
        return 0;
    }
    for (size_t i = 0; i < ARRAY_SIZE(inputs); ++i) {
        int err = gpio_is_ready_dt(&inputs[i]) ?
                  gpio_pin_configure_dt(&inputs[i], GPIO_INPUT) : -ENODEV;
        if (err) {
            rev58_status.error = err;
            printk("GPIO input %u initialization failed: %d\n", (unsigned int)i, err);
            return 0;
        }
    }
    rev58_status.error = rev58_peripheral_checks();
    if (rev58_status.error) {
        printk("Peripheral check failed: %d\n", rev58_status.error);
        return 0;
    }
#ifdef CONFIG_JPARC_SPI4_REGS_TEST
    rev58_status.error = spi4_test_server_start();
    if (rev58_status.error) {
        printk("SPI4 server initialization failed: %d\n", rev58_status.error);
        return 0;
    }
#endif
    printk("Bring-up ready; inspect rev58_status.ticks and raw GPIO levels\n");
    for (;;) {
        rev58_status.ready_raw = gpio_pin_get_raw(inputs[0].port, inputs[0].pin);
        rev58_status.fault_raw = gpio_pin_get_raw(inputs[1].port, inputs[1].pin);
        rev58_status.irq_raw = gpio_pin_get_raw(inputs[2].port, inputs[2].pin);
        ++rev58_status.ticks;
        rev58_peripheral_poll();
        k_sleep(K_SECONDS(1));
    }
    return 0;
}
```

## src/adc_dummy_test.c
```c
/* SPDX-License-Identifier: Apache-2.0 */
#include <zephyr/kernel.h>
#include <zephyr/drivers/dma.h>
#include <zephyr/drivers/spi.h>
#include <zephyr/sys/atomic.h>
#include <stm32_ll_bus.h>
#include <stm32_ll_spi.h>
#include <stdio.h>
#include <string.h>
#include "adc_dummy_test.h"
#include "adc_stream.h"

#define RX DT_NODELABEL(spi1)
#define RING_SIZE 32768u
#define HALF_SIZE (RING_SIZE / 2u)
#define SPI_ERRORS (SPI_SR_OVR | SPI_SR_MODF | SPI_SR_TIFRE)
BUILD_ASSERT(!IS_ENABLED(CONFIG_DCACHE), "DMA buffers require D-cache disabled");
BUILD_ASSERT(!IS_ENABLED(CONFIG_SPI_STM32_DMA), "SPI1 DMA is exclusively application-owned");
BUILD_ASSERT(DT_DMAS_CELL_BY_NAME(RX, rx, channel) == 0, "Reserve DMA1 stream 0");
BUILD_ASSERT(DT_DMAS_CELL_BY_NAME(RX, rx, slot) == 37, "SPI1_RX DMAMUX request");
/* AXI SRAM, never DTCM; verified in the build artifact checker. */
static uint8_t adc_dma_ring[RING_SIZE] __aligned(32);
static uint8_t scratch[HALF_SIZE] __aligned(32);
static const struct device *const mux = DEVICE_DT_GET(DT_DMAS_CTLR_BY_NAME(RX, rx));
static atomic_t completed, dma_errors;
static K_SEM_DEFINE(rx_event, 0, 1);
static struct adc_stream_stats stats;
static uint32_t consumed, overrun, spi_errors;

static void dma_done(const struct device *dev, void *user, uint32_t channel, int status)
{
    ARG_UNUSED(dev); ARG_UNUSED(user); ARG_UNUSED(channel);
    if (status < 0) {
        atomic_inc(&dma_errors);
    } else {
        /* STM32 circular mode signals half (BLOCK), then full (COMPLETE). */
        unsigned int expected = (atomic_get(&completed) & 1) ?
                                DMA_STATUS_COMPLETE : DMA_STATUS_BLOCK;
        if ((unsigned int)status != expected) { atomic_inc(&dma_errors); }
        atomic_inc(&completed);
    }
    k_sem_give(&rx_event);
}

static int rx_start(void)
{
    if (!device_is_ready(DEVICE_DT_GET(RX)) || !device_is_ready(mux)) { return -ENODEV; }
    consumed = overrun = spi_errors = 0;
    atomic_clear(&completed);
    atomic_clear(&dma_errors);
    k_sem_reset(&rx_event);
    /* No SPI API caller may access SPI1 while this module owns it. */
    LL_SPI_Disable(SPI1);
    LL_APB2_GRP1_ForceReset(LL_APB2_GRP1_PERIPH_SPI1);
    LL_APB2_GRP1_ReleaseReset(LL_APB2_GRP1_PERIPH_SPI1);
    LL_SPI_SetMode(SPI1, LL_SPI_MODE_SLAVE);
    LL_SPI_SetTransferDirection(SPI1, LL_SPI_SIMPLEX_RX);
    LL_SPI_SetDataWidth(SPI1, LL_SPI_DATAWIDTH_8BIT);
    LL_SPI_SetFIFOThreshold(SPI1, LL_SPI_FIFO_TH_01DATA);
    LL_SPI_SetClockPolarity(SPI1, LL_SPI_POLARITY_LOW);
    LL_SPI_SetClockPhase(SPI1, LL_SPI_PHASE_1EDGE);
    LL_SPI_SetTransferBitOrder(SPI1, LL_SPI_MSB_FIRST);
    LL_SPI_SetNSSMode(SPI1, LL_SPI_NSS_HARD_INPUT);
    LL_SPI_SetTransferSize(SPI1, 0); /* Unlimited RX across NSS boundaries. */
    SPI1->IFCR = 0xffffffff;
    struct dma_block_config block = {
        .source_address = (uintptr_t)&SPI1->RXDR,
        .dest_address = (uintptr_t)adc_dma_ring,
        .block_size = sizeof(adc_dma_ring),
        .source_addr_adj = DMA_ADDR_ADJ_NO_CHANGE,
        .dest_addr_adj = DMA_ADDR_ADJ_INCREMENT,
        .source_reload_en = 1, .dest_reload_en = 1,
    };
    struct dma_config cfg = {
        .dma_slot = DT_DMAS_CELL_BY_NAME(RX, rx, slot),
        .channel_direction = PERIPHERAL_TO_MEMORY,
        .source_data_size = 1, .dest_data_size = 1,
        .source_burst_length = 1, .dest_burst_length = 1,
        .channel_priority = 3, .block_count = 1, .head_block = &block,
        .dma_callback = dma_done,
    };
    int rc = dma_config(mux, 0, &cfg);
    if (!rc) { rc = dma_start(mux, 0); }
    if (rc) { dma_stop(mux, 0); return rc; }
    LL_SPI_EnableDMAReq_RX(SPI1);
    LL_SPI_Enable(SPI1);
    return 0;
}

static int consume_blocks(void)
{
    spi_errors |= SPI1->SR & SPI_ERRORS;
    if (spi_errors || atomic_get(&dma_errors)) { return -EIO; }
    uint32_t produced = atomic_get(&completed);
    if (produced - consumed > 1) { ++overrun; return -EOVERFLOW; }
    if (produced == consumed) { return 0; }
    memcpy(scratch, &adc_dma_ring[(consumed & 1u) * HALF_SIZE], HALF_SIZE);
    __DMB();
    /* The DMA must not have returned to this half while it was being copied. */
    if ((uint32_t)atomic_get(&completed) != produced) { ++overrun; return -EOVERFLOW; }
    ++consumed;
    adc_stream_feed(&stats, scratch, sizeof(scratch));
    return 0;
}

static int rx_finish(void)
{
    /* FPGA has stopped and BUSY is clear; allow its final bytes to reach RAM. */
    k_busy_wait(50);
    k_sleep(K_MSEC(1));
    spi_errors |= SPI1->SR & SPI_ERRORS;
    LL_SPI_DisableDMAReq_RX(SPI1);
    struct dma_status status = {0};
    int rc = dma_get_status(mux, 0, &status);
    int stopped = dma_stop(mux, 0);
    LL_SPI_Disable(SPI1);
    if (rc || stopped) { return rc ? rc : stopped; }
    rc = consume_blocks();
    if (rc) { return rc; }
    uint32_t pos = (RING_SIZE - status.pending_length) % RING_SIZE;
    uint32_t begin = (consumed & 1u) * HALF_SIZE;
    if (pos < begin || pos - begin >= HALF_SIZE) { ++overrun; return -EOVERFLOW; }
    adc_stream_feed(&stats, &adc_dma_ring[begin], pos - begin);
    return 0;
}

struct control {
    spi4_transfer_fn transfer;
    void *context;
    char error[SPI4_REPLY_SIZE];
};
static bool access(struct control *c, uint8_t op, uint16_t addr, uint32_t data, uint32_t *out)
{
    return spi4_exchange(c->transfer, c->context, op, addr, data, out, c->error);
}
static bool read_reg(struct control *c, uint16_t addr, uint32_t *value)
{
    return access(c, 3, addr, 0, value);
}
static bool write_reg(struct control *c, uint16_t addr, uint32_t value, uint32_t expected)
{
    uint32_t actual;
    if (!access(c, 2, addr, value, &actual) || !read_reg(c, addr, &actual)) { return false; }
    if (actual != expected) {
        snprintf(c->error, sizeof(c->error), "ERR ADC_CONTROL_VERIFY 0x%04x\n", addr);
        return false;
    }
    return true;
}
static bool wait_idle(struct control *c)
{
    int64_t deadline = k_uptime_get() + 20;
    do {
        uint32_t value;
        if (!read_reg(c, 0x0404, &value)) { return false; }
        if (!(value & BIT(16))) { return true; }
        k_usleep(50);
    } while (k_uptime_get() < deadline);
    strcpy(c->error, "ERR ADC_BUSY_TIMEOUT\n");
    return false;
}

bool adc_dummy_command(char *line, char reply[SPI4_REPLY_SIZE],
                       spi4_transfer_fn transfer, void *context)
{
    if (strncmp(line, "ADCTEST", 7) != 0) { return false; }
    char token[6][24];
    uint32_t ms, values[3];
    int n = sscanf(line, "%23s %23s %23s %23s %23s %23s",
                   token[0], token[1], token[2], token[3], token[4], token[5]);
    if (n != 5 || strcmp(token[0], "ADCTEST") ||
        !spi4_number(token[1], 3000, &ms) || ms < 100 ||
        !spi4_number(token[2], 0xffffff, &values[0]) ||
        !spi4_number(token[3], 0xffffff, &values[1]) ||
        !spi4_number(token[4], 0xffffff, &values[2])) {
        strcpy(reply, "ERR COMMAND ADCTEST milliseconds(100..3000) raw1 raw2 raw3\n");
        return true;
    }
    struct control ctrl = {.transfer = transfer, .context = context};
    uint32_t id, version, caps, channels;
    if (!read_reg(&ctrl, 0, &id) || !read_reg(&ctrl, 4, &version) ||
        !read_reg(&ctrl, 8, &caps) || !read_reg(&ctrl, 0x040c, &channels)) {
        strcpy(reply, ctrl.error); return true;
    }
    if (id != SPI4_DEVICE_ID || version != 0x00010003 || caps != 0x0f || channels != 3) {
        strcpy(reply, "ERR ADC_REQUIRES_V1_3_CAPS_0F_CHANNELS_3\n"); return true;
    }
    adc_stream_init(&stats, values);
    consumed = overrun = spi_errors = 0;
    atomic_clear(&completed);
    atomic_clear(&dma_errors);
    bool armed = false, ok = false;
    int rc = 0, cleanup_error = 0;
    uint32_t tx_count = 0, drops[3] = {0}, restarts[3] = {0};
    int64_t start = 0, elapsed = 0;
    if (!write_reg(&ctrl, 0x0400, 0, 0) || !wait_idle(&ctrl)) { goto cleanup; }
    for (unsigned int ch = 0; ch < 3; ++ch) {
        if (!write_reg(&ctrl, 0x0484 + 4 * ch, values[ch], values[ch])) { goto cleanup; }
    }
    if (!write_reg(&ctrl, 0x0480, 1, 1)) { goto cleanup; }
    rc = rx_start();
    if (rc) { goto cleanup; }
    armed = true;
    start = k_uptime_get();
    /* Clear/start only after DMA is enabled; clear bit reads back as zero. */
    if (!write_reg(&ctrl, 0x0400, 3, 1)) { goto cleanup; }
    while (k_uptime_get() - start < ms) {
        rc = consume_blocks();
        if (rc) { goto cleanup; }
        k_sem_take(&rx_event, K_MSEC(1));
    }
    /* The source keeps generating after TX is stopped. Reading DROP after stop
     * would measure our deliberate FIFO accumulation, not streaming loss.
     * Capture diagnostics while TX still runs, draining DMA between reads.
     */
    for (unsigned int ch = 0; ch < 3; ++ch) {
        if (!read_reg(&ctrl, 0x0420 + 4 * ch, &drops[ch]) ||
            !read_reg(&ctrl, 0x0430 + 4 * ch, &restarts[ch])) { goto cleanup; }
        rc = consume_blocks();
        if (rc) { goto cleanup; }
    }
    ok = true;
cleanup:
    /* Always stop even if the client disconnected or the test failed. */
    {
        char first_error[SPI4_REPLY_SIZE];
        strcpy(first_error, ctrl.error);
        if (!write_reg(&ctrl, 0x0400, 0, 0) || !wait_idle(&ctrl)) {
            cleanup_error = -EIO; ok = false;
        }
        elapsed = start ? k_uptime_get() - start : 0;
        if (armed) {
            int end_rc = rx_finish();
            if (end_rc && !rc) { rc = end_rc; }
        }
        /* TX count is stable after STOP/BUSY; compare every transmitted record. */
        if (!read_reg(&ctrl, 0x0408, &tx_count)) { ok = false; }
        if (!write_reg(&ctrl, 0x0480, 0, 0)) { cleanup_error = -EIO; ok = false; }
        if (first_error[0]) { strcpy(ctrl.error, first_error); }
    }
    uint32_t received = 0;
    ok = ok && !rc && !cleanup_error && !stats.crc_errors && !stats.header_errors &&
         !stats.discarded_bytes && !stats.pending_size && !overrun &&
         !spi_errors && !atomic_get(&dma_errors);
    for (unsigned int ch = 0; ch < 3; ++ch) {
        struct adc_channel_stats *c = &stats.channel[ch];
        received += c->records;
        /* 10% envelope includes scheduling and SPI4 start/stop latency. */
        uint64_t nominal = (uint64_t)ms * 78125 / 1000;
        ok = ok && c->records >= nominal * 9 / 10 && c->records <= nominal * 11 / 10 &&
             !c->value_errors && !c->sequence_errors && !drops[ch] && !restarts[ch];
    }
    ok = ok && received == tx_count;
    int used = snprintf(reply, SPI4_REPLY_SIZE,
        "OK ADC {\"pass\":%s,\"requested_ms\":%u,\"elapsed_ms\":%lld,"
        "\"received\":%u,\"fpga_tx\":%u,\"crc_errors\":%u,\"header_errors\":%u,"
        "\"discarded_bytes\":%u,\"trailing_bytes\":%u,\"dma_errors\":%ld,"
        "\"dma_overruns\":%u,\"spi_error_flags\":%u,\"error\":%d,"
        "\"control_error\":%s,\"cleanup_error\":%d,\"channels\":[",
        ok ? "true" : "false", ms, (long long)elapsed, received, tx_count,
        stats.crc_errors, stats.header_errors, stats.discarded_bytes,
        (unsigned int)stats.pending_size, (long)atomic_get(&dma_errors),
        overrun, spi_errors, rc, ctrl.error[0] ? "true" : "false", cleanup_error);
    for (unsigned int ch = 0; ch < 3; ++ch) {
        struct adc_channel_stats *c = &stats.channel[ch];
        used += snprintf(reply + used, SPI4_REPLY_SIZE - used,
            "%s{\"channel\":%u,\"records\":%u,\"expected\":%u,\"last\":%u,"
            "\"first_seq\":%u,\"last_seq\":%u,\"value_errors\":%u,"
            "\"sequence_errors\":%u,\"fpga_drop\":%u,\"fpga_restart\":%u}",
            ch ? "," : "", ch + 1, c->records, values[ch], c->last_value,
            c->first_sequence, c->last_sequence, c->value_errors,
            c->sequence_errors, drops[ch], restarts[ch]);
    }
    snprintf(reply + used, SPI4_REPLY_SIZE - used, "]}\n");
    return true;
}
```

## src/adc_dummy_test.h
```c
/* SPDX-License-Identifier: Apache-2.0 */
#ifndef JPARC_ADC_DUMMY_TEST_H
#define JPARC_ADC_DUMMY_TEST_H
#include "spi4_protocol.h"
/* Called only by the SPI4 server owner. Returns false for unrelated commands. */
bool adc_dummy_command(char *line, char reply[SPI4_REPLY_SIZE],
                       spi4_transfer_fn transfer, void *context);
#endif
```

## src/board_io_test.c
```c
/* SPDX-License-Identifier: Apache-2.0 */
#include <zephyr/kernel.h>
#include <zephyr/drivers/gpio.h>
#include <zephyr/drivers/uart.h>
#include <zephyr/sys/ring_buffer.h>
#include <stdio.h>
#include <string.h>
#include "board_io_protocol.h"
#include "board_io_test.h"
#define USER DT_PATH(zephyr_user)
#define SPEC(node, prop, idx) GPIO_DT_SPEC_GET_BY_IDX(node, prop, idx),
static const struct gpio_dt_spec inputs[] = { DT_FOREACH_PROP_ELEM(USER, plc_input_gpios, SPEC) };
static const struct gpio_dt_spec outputs[] = { DT_FOREACH_PROP_ELEM(USER, plc_output_gpios, SPEC) };
BUILD_ASSERT(ARRAY_SIZE(inputs) == 16 && ARRAY_SIZE(outputs) == 16, "PLC mapping size");
BUILD_ASSERT(DT_PROP(DT_NODELABEL(uart8), tx_rx_swap), "Motherboard requires swapped UART8");
static const struct device *const serial = DEVICE_DT_GET(DT_NODELABEL(uart8));
RING_BUF_DECLARE(rx_ring, 1024);
static uint32_t rx_total, rx_dropped, error_flags, tx_total;
static uint16_t output_latch;
static const struct gpio_dt_spec acc_inputs[] = {
    GPIO_DT_SPEC_GET(USER, sync_gpios), GPIO_DT_SPEC_GET(USER, trigger_gpios)
};
int board_acc_read(void *unused, uint32_t *levels)
{
    ARG_UNUSED(unused);
    *levels = 0;
    for (unsigned i = 0; i < ARRAY_SIZE(acc_inputs); ++i) {
        int level = gpio_pin_get_raw(acc_inputs[i].port, acc_inputs[i].pin);
        if (level < 0) { return level; }
        *levels |= (uint32_t)level << (i + 1); /* Same bit positions as FPGA. */
    }
    return 0;
}
static void serial_irq(const struct device *dev, void *unused)
{
    ARG_UNUSED(unused);
    uart_irq_update(dev);
    int errors = uart_err_check(dev);
    if (errors > 0) { error_flags |= errors; }
    while (uart_irq_rx_ready(dev)) {
        uint8_t data[32];
        int n = uart_fifo_read(dev, data, sizeof(data));
        if (n <= 0) { break; }
        rx_total += n;
        rx_dropped += n - ring_buf_put(&rx_ring, data, n);
    }
}
static int set_outputs(uint16_t mask)
{
    /* Clear old bits before setting new ones. This is not an atomic bus write. */
    for (unsigned value = 0; value <= 1; ++value) {
        for (unsigned i = 0; i < 16; ++i) {
            if (((mask >> i) & 1u) != value) { continue; }
            int rc = gpio_pin_set_raw(outputs[i].port, outputs[i].pin, value);
            if (rc) {
                /* Best effort all-low after a partial write; never claim success. */
                for (unsigned j = 0; j < 16; ++j) {
                    gpio_pin_set_raw(outputs[j].port, outputs[j].pin, 0);
                }
                output_latch = 0;
                return rc;
            }
        }
    }
    output_latch = mask;
    return 0;
}
int board_io_init(void)
{
    /* Shared with MAX10 and external drivers: inputs only, no pulls/EXTI. */
    for (unsigned i = 0; i < ARRAY_SIZE(acc_inputs); ++i) {
        if (!gpio_is_ready_dt(&acc_inputs[i])) { return -ENODEV; }
        int rc = gpio_pin_configure_dt(&acc_inputs[i], GPIO_INPUT);
        if (rc) { return rc; }
    }
    for (unsigned i = 0; i < 16; ++i) {
        if (!gpio_is_ready_dt(&outputs[i]) || !gpio_is_ready_dt(&inputs[i])) { return -ENODEV; }
        int rc = gpio_pin_configure_dt(&outputs[i], GPIO_OUTPUT_LOW);
        if (rc) { return rc; }
        rc = gpio_pin_configure_dt(&inputs[i], GPIO_INPUT);
        if (rc) { return rc; }
    }
    if (!device_is_ready(serial)) { return -ENODEV; }
    int rc = uart_irq_callback_user_data_set(serial, serial_irq, NULL);
    if (rc) { return rc; }
    uart_irq_rx_enable(serial);
    uart_irq_err_enable(serial);
    return 0;
}
bool board_io_command(const char *line, char reply[SPI4_REPLY_SIZE])
{
    struct board_io_request r = board_io_parse(line);
    if (r.kind == IO_UNKNOWN) { return false; }
    if (r.kind == IO_INVALID) { strcpy(reply, "ERR BOARD_IO_COMMAND\n"); return true; }
    if (r.kind == PLC_WRITE) {
        int rc = set_outputs(r.mask);
        if (rc) { snprintf(reply, SPI4_REPLY_SIZE, "ERR PLC_WRITE %d\n", rc); return true; }
    }
    if (r.kind == PLC_WRITE || r.kind == PLC_READ) {
        uint16_t in = 0, out = 0;
        for (unsigned i = 0; i < 16; ++i) {
            int a = gpio_pin_get_raw(inputs[i].port, inputs[i].pin);
            int b = gpio_pin_get_raw(outputs[i].port, outputs[i].pin);
            if (a < 0 || b < 0) { strcpy(reply, "ERR PLC_READ\n"); return true; }
            in |= a << i; out |= b << i;
        }
        snprintf(reply, SPI4_REPLY_SIZE,
            "OK PLC {\"input_raw\":%u,\"output_raw\":%u,\"output_latch\":%u}\n",
            in, out, output_latch);
        return true;
    }
    if (r.kind == UART_SEND) {
        for (size_t i = 0; i < r.size; ++i) { uart_poll_out(serial, r.data[i]); }
        tx_total += r.size;
    }
    uint8_t data[128]; uint32_t n = 0;
    unsigned key = irq_lock();
    if (r.kind == UART_CLEAR) {
        ring_buf_reset(&rx_ring); rx_total = rx_dropped = error_flags = tx_total = 0;
    }
    if (r.kind == UART_READ) { n = ring_buf_get(&rx_ring, data, sizeof(data)); }
    uint32_t total = rx_total, dropped = rx_dropped, errors = error_flags;
    uint32_t buffered = ring_buf_size_get(&rx_ring), sent = tx_total;
    irq_unlock(key);
    char hex[257];
    for (uint32_t i = 0; i < n; ++i) { snprintf(hex + 2*i, 3, "%02x", data[i]); }
    hex[2*n] = '\0';
    snprintf(reply, SPI4_REPLY_SIZE,
        "OK UART {\"baud\":115200,\"rx_total\":%u,\"rx_dropped\":%u,"
        "\"error_flags\":%u,\"buffered\":%u,\"tx_total\":%u,\"hex\":\"%s\"}\n",
        total, dropped, errors, buffered, sent, hex);
    return true;
}
```

## src/board_io_test.h
```c
/* SPDX-License-Identifier: Apache-2.0 */
#ifndef REV58_BOARD_IO_TEST_H
#define REV58_BOARD_IO_TEST_H
#include "spi4_protocol.h"
int board_io_init(void);
int board_acc_read(void *unused, uint32_t *levels);
bool board_io_command(const char *line, char reply[SPI4_REPLY_SIZE]);
#endif
```

## src/mixed_adc_test.c
```c
/* SPDX-License-Identifier: Apache-2.0 */
#include <zephyr/kernel.h>
#include <zephyr/drivers/dma.h>
#include <zephyr/drivers/spi.h>
#include <zephyr/sys/atomic.h>
#include <stm32_ll_bus.h>
#include <stm32_ll_spi.h>
#include <stdio.h>
#include <string.h>
#include "mixed_adc_test.h"
#include "mixed_stream.h"

#define RX DT_NODELABEL(spi1)
#define RING_SIZE 30720u
#define HALF_SIZE (RING_SIZE / 2u)
BUILD_ASSERT(HALF_SIZE % 48 == 0 && HALF_SIZE % 32 == 0, "DMA frame alignment");
#define SPI_ERRORS (SPI_SR_OVR | SPI_SR_MODF | SPI_SR_TIFRE)
BUILD_ASSERT(!IS_ENABLED(CONFIG_DCACHE), "DMA buffers require D-cache disabled");
BUILD_ASSERT(!IS_ENABLED(CONFIG_SPI_STM32_DMA), "SPI1 DMA is exclusively application-owned");
BUILD_ASSERT(DT_DMAS_CELL_BY_NAME(RX, rx, channel) == 0, "Reserve DMA1 stream 0");
BUILD_ASSERT(DT_DMAS_CELL_BY_NAME(RX, rx, slot) == 37, "SPI1_RX DMAMUX request");
/* AXI SRAM, never DTCM; verified in the build artifact checker. */
static uint8_t adc_dma_ring[RING_SIZE] __aligned(32);
static uint8_t scratch[HALF_SIZE] __aligned(32);
static const struct device *const mux = DEVICE_DT_GET(DT_DMAS_CTLR_BY_NAME(RX, rx));
static atomic_t completed, dma_errors;
static K_SEM_DEFINE(rx_event, 0, 1);
static struct mixed_stats stats;
static uint32_t consumed, overrun, spi_errors;

static void dma_done(const struct device *dev, void *user, uint32_t channel, int status)
{
    ARG_UNUSED(dev); ARG_UNUSED(user); ARG_UNUSED(channel);
    if (status < 0) {
        atomic_inc(&dma_errors);
    } else {
        /* STM32 circular mode signals half (BLOCK), then full (COMPLETE). */
        unsigned int expected = (atomic_get(&completed) & 1) ?
                                DMA_STATUS_COMPLETE : DMA_STATUS_BLOCK;
        if ((unsigned int)status != expected) { atomic_inc(&dma_errors); }
        atomic_inc(&completed);
    }
    k_sem_give(&rx_event);
}

static int rx_start(void)
{
    if (!device_is_ready(DEVICE_DT_GET(RX)) || !device_is_ready(mux)) { return -ENODEV; }
    consumed = overrun = spi_errors = 0;
    atomic_clear(&completed);
    atomic_clear(&dma_errors);
    k_sem_reset(&rx_event);
    /* No SPI API caller may access SPI1 while this module owns it. */
    LL_SPI_Disable(SPI1);
    LL_APB2_GRP1_ForceReset(LL_APB2_GRP1_PERIPH_SPI1);
    LL_APB2_GRP1_ReleaseReset(LL_APB2_GRP1_PERIPH_SPI1);
    LL_SPI_SetMode(SPI1, LL_SPI_MODE_SLAVE);
    LL_SPI_SetTransferDirection(SPI1, LL_SPI_SIMPLEX_RX);
    LL_SPI_SetDataWidth(SPI1, LL_SPI_DATAWIDTH_8BIT);
    LL_SPI_SetFIFOThreshold(SPI1, LL_SPI_FIFO_TH_01DATA);
    LL_SPI_SetClockPolarity(SPI1, LL_SPI_POLARITY_LOW);
    LL_SPI_SetClockPhase(SPI1, LL_SPI_PHASE_1EDGE);
    LL_SPI_SetTransferBitOrder(SPI1, LL_SPI_MSB_FIRST);
    LL_SPI_SetNSSMode(SPI1, LL_SPI_NSS_HARD_INPUT);
    LL_SPI_SetTransferSize(SPI1, 0); /* Unlimited RX across NSS boundaries. */
    SPI1->IFCR = 0xffffffff;
    struct dma_block_config block = {
        .source_address = (uintptr_t)&SPI1->RXDR,
        .dest_address = (uintptr_t)adc_dma_ring,
        .block_size = sizeof(adc_dma_ring),
        .source_addr_adj = DMA_ADDR_ADJ_NO_CHANGE,
        .dest_addr_adj = DMA_ADDR_ADJ_INCREMENT,
        .source_reload_en = 1, .dest_reload_en = 1,
    };
    struct dma_config cfg = {
        .dma_slot = DT_DMAS_CELL_BY_NAME(RX, rx, slot),
        .channel_direction = PERIPHERAL_TO_MEMORY,
        .source_data_size = 1, .dest_data_size = 1,
        .source_burst_length = 1, .dest_burst_length = 1,
        .channel_priority = 3, .block_count = 1, .head_block = &block,
        .dma_callback = dma_done,
    };
    int rc = dma_config(mux, 0, &cfg);
    if (!rc) { rc = dma_start(mux, 0); }
    if (rc) { dma_stop(mux, 0); return rc; }
    LL_SPI_EnableDMAReq_RX(SPI1);
    LL_SPI_Enable(SPI1);
    return 0;
}

static int consume_blocks(void)
{
    spi_errors |= SPI1->SR & SPI_ERRORS;
    if (spi_errors || atomic_get(&dma_errors)) { return -EIO; }
    uint32_t produced = atomic_get(&completed);
    if (produced - consumed > 1) { ++overrun; return -EOVERFLOW; }
    if (produced == consumed) { return 0; }
    memcpy(scratch, &adc_dma_ring[(consumed & 1u) * HALF_SIZE], HALF_SIZE);
    __DMB();
    /* The DMA must not have returned to this half while it was being copied. */
    if ((uint32_t)atomic_get(&completed) != produced) { ++overrun; return -EOVERFLOW; }
    ++consumed;
    mixed_stream_feed(&stats, scratch, sizeof(scratch));
    return 0;
}

static int rx_finish(void)
{
    /* FPGA has stopped and BUSY is clear; allow its final bytes to reach RAM. */
    k_busy_wait(50);
    k_sleep(K_MSEC(1));
    spi_errors |= SPI1->SR & SPI_ERRORS;
    LL_SPI_DisableDMAReq_RX(SPI1);
    struct dma_status status = {0};
    int rc = dma_get_status(mux, 0, &status);
    int stopped = dma_stop(mux, 0);
    LL_SPI_Disable(SPI1);
    if (rc || stopped) { return rc ? rc : stopped; }
    rc = consume_blocks();
    if (rc) { return rc; }
    uint32_t pos = (RING_SIZE - status.pending_length) % RING_SIZE;
    uint32_t begin = (consumed & 1u) * HALF_SIZE;
    if (pos < begin || pos - begin >= HALF_SIZE) { ++overrun; return -EOVERFLOW; }
    mixed_stream_feed(&stats, &adc_dma_ring[begin], pos - begin);
    return 0;
}

struct control {
    spi4_transfer_fn transfer;
    void *context;
    char error[SPI4_REPLY_SIZE];
};
static bool access(struct control *c, uint8_t op, uint16_t addr, uint32_t data, uint32_t *out)
{
    return spi4_exchange(c->transfer, c->context, op, addr, data, out, c->error);
}
static bool read_reg(struct control *c, uint16_t addr, uint32_t *value)
{
    return access(c, 3, addr, 0, value);
}
static bool write_reg(struct control *c, uint16_t addr, uint32_t value, uint32_t expected)
{
    uint32_t actual;
    if (!access(c, 2, addr, value, &actual) || !read_reg(c, addr, &actual)) { return false; }
    if (actual != expected) {
        snprintf(c->error, sizeof(c->error), "ERR ADC_CONTROL_VERIFY 0x%04x\n", addr);
        return false;
    }
    return true;
}
static bool wait_idle(struct control *c)
{
    int64_t deadline = k_uptime_get() + 20;
    do {
        uint32_t value;
        if (!read_reg(c, 0x0404, &value)) { return false; }
        if (!(value & BIT(16))) { return true; }
        k_usleep(50);
    } while (k_uptime_get() < deadline);
    strcpy(c->error, "ERR ADC_BUSY_TIMEOUT\n");
    return false;
}

/* APPLY always submits a new atomic snapshot. Readback of CONTROL is not ACK. */
static bool apply_enable(struct control *c, uint32_t enable)
{
    uint32_t status, before, submitted, applied, value, expected[5];
    if (!read_reg(c, 0x0518, &status) || (status & 1) ||
        !read_reg(c, 0x0530, &before)) { return false; }
    for (unsigned i = 0; i < 5; ++i) {
        if (!read_reg(c, 0x0504 + 4 * i, &expected[i])) { return false; }
    }
    if (!write_reg(c, 0x0500, 2 | enable, enable) ||
        !read_reg(c, 0x0530, &submitted) || submitted != before + UINT32_C(1)) { return false; }
    int64_t deadline = k_uptime_get() + 100;
    do {
        if (!read_reg(c, 0x0518, &status) || (status & 2)) { return false; }
        if (!(status & 1)) {
            if (!read_reg(c, 0x051c, &applied) || applied != submitted ||
                !read_reg(c, 0x0554, &value) || value != enable) { return false; }
            for (unsigned i = 0; i < 5; ++i) {
                if (!read_reg(c, 0x0540 + 4 * i, &value) || value != expected[i]) { return false; }
            }
            return true;
        }
        k_usleep(50);
    } while (k_uptime_get() < deadline);
    return false;
}

bool mixed_adc_command(char *line, char reply[SPI4_REPLY_SIZE],
                       spi4_transfer_fn transfer, void *context)
{
    if (strncmp(line, "MIXCAP", 6)) { return false; }
    char t[9][24]; uint32_t args[7];
    int n = sscanf(line, "%23s %23s %23s %23s %23s %23s %23s %23s %23s",
                   t[0], t[1], t[2], t[3], t[4], t[5], t[6], t[7], t[8]);
    if (n != 8 || strcmp(t[0], "MIXCAP")) { goto syntax; }
    const uint32_t limits[] = {3000, 1, 7, 65535, 0xffffff, 0xffffff, 0xffffff};
    for (unsigned i = 0; i < 7; ++i) {
        if (!spi4_number(t[i + 1], limits[i], &args[i])) { goto syntax; }
    }
    if (args[0] < 100) { goto syntax; }
    struct control ctrl = {.transfer = transfer, .context = context};
    uint32_t id, version, caps, count, mask, negate, period, status, enabled;
    if (!read_reg(&ctrl, 0, &id) || !read_reg(&ctrl, 4, &version) ||
        !read_reg(&ctrl, 8, &caps) || !read_reg(&ctrl, 0x040c, &count) ||
        id != SPI4_DEVICE_ID || !((version == 0x00020000 && caps == 0x3f) ||
          (version == 0x00020001 && caps == 0x7f) ||
          (version == 0x00020002 && caps == 0xff)) || count != 3 ||
        !read_reg(&ctrl, 0x0560, &count) || count != 8) {
        strcpy(reply, "ERR MIX_REQUIRES_V2_CAPS_3F_CHANNELS_3_8\n"); return true;
    }
    if (!read_reg(&ctrl, 0x0060, &mask) || mask || !read_reg(&ctrl, 0x0510, &negate)) {
        strcpy(reply, "ERR MIX_REQUIRES_MANUAL_DAC_MASK_ZERO\n"); return true;
    }
    if (!read_reg(&ctrl, 0x0554, &enabled) || enabled ||
        !read_reg(&ctrl, 0x0518, &status) || (status & 3) ||
        !read_reg(&ctrl, 0x0514, &period) || !period) {
        strcpy(reply, "ERR MIX_CONFIGURE_STOPPED_FIRST\n"); return true;
    }
    mixed_stream_init(&stats, args[1], args[2], args[3], negate, args + 4);
    consumed = overrun = spi_errors = 0;
    atomic_clear(&completed); atomic_clear(&dma_errors);
    bool armed = false, ok = false;
    int rc = 0, cleanup = 0;
    uint32_t tx = 0, diagnostics[3] = {0}, restarts[3] = {0}, replaced[3] = {0};
    int64_t start = 0, elapsed = 0;
    if (!write_reg(&ctrl, 0x0400, 0, 0) || !wait_idle(&ctrl)) { goto finish; }
    for (unsigned i = 0; i < 3; ++i) {
        if (!write_reg(&ctrl, 0x0484 + 4 * i, args[4 + i], args[4 + i])) { goto finish; }
    }
    if (!write_reg(&ctrl, 0x0480, args[1], args[1]) || !apply_enable(&ctrl, 1)) { goto finish; }
    rc = rx_start(); if (rc) { goto finish; } armed = true;
    start = k_uptime_get();
    if (!write_reg(&ctrl, 0x0400, 3, 1)) { goto finish; }
    while (k_uptime_get() - start < args[0]) {
        rc = consume_blocks(); if (rc) { goto finish; }
        k_sem_take(&rx_event, K_MSEC(1));
    }
    ok = true;
finish:
    /* Stop acquisition first, then drain the TX queue before stopping SPI1.
     * Cleanup runs inside the MCU even when the host disconnects. */
    if (!apply_enable(&ctrl, 0)) { cleanup = -EIO; }
    if (armed) {
        int64_t deadline = k_uptime_get() + 20;
        uint32_t status = 0;
        do {
            int drain_rc = consume_blocks(); if (drain_rc && !rc) { rc = drain_rc; }
            if (!read_reg(&ctrl, 0x0404, &status)) { cleanup = -EIO; break; }
            if ((status & BIT(8)) && !(status & BIT(16))) { break; }
            k_usleep(50);
        } while (k_uptime_get() < deadline);
        if (!(status & BIT(8)) || (status & BIT(16))) { cleanup = -ETIMEDOUT; }
    }
    if (!write_reg(&ctrl, 0x0400, 0, 0) || !wait_idle(&ctrl)) { cleanup = -EIO; }
    elapsed = start ? k_uptime_get() - start : 0;
    if (armed) { int end_rc = rx_finish(); if (end_rc && !rc) { rc = end_rc; } }
    const uint16_t diagnostic_regs[] = {0x0524, 0x0528, 0x0538};
    for (unsigned i = 0; i < 3; ++i) {
        if (!read_reg(&ctrl, diagnostic_regs[i], &diagnostics[i])) { ok = false; }
    }
    for (unsigned i = 0; i < 3; ++i) {
        if (!read_reg(&ctrl, 0x0430 + 4 * i, &restarts[i]) ||
            !read_reg(&ctrl, 0x0420 + 4 * i, &replaced[i])) { ok = false; }
    }
    if (!read_reg(&ctrl, 0x0408, &tx)) { ok = false; }
    /* Leave dummy mode explicitly; this clears flow counters after their snapshot. */
    if (!write_reg(&ctrl, 0x0480, 0, 0)) { cleanup = -EIO; }
    ok = ok && !rc && !cleanup && !ctrl.error[0] && stats.frames && stats.frames == tx &&
        !stats.crc_errors && !stats.discarded && !stats.used && !stats.sequence_errors &&
        !stats.flag_errors && !stats.value_errors && !overrun && !spi_errors &&
        !atomic_get(&dma_errors) && !diagnostics[0] && !diagnostics[1] && !diagnostics[2];
    uint64_t nominal = (uint64_t)args[0] * 40000 / period;
    ok = ok && stats.frames >= nominal * 9 / 10 && stats.frames <= nominal * 11 / 10 + 4;
    for (unsigned i = 0; i < 3; ++i) {
        if ((stats.required & BIT(i)) && (!stats.known[i] || stats.stale[i] || restarts[i])) { ok = false; }
    }
    int used = snprintf(reply, SPI4_REPLY_SIZE,
        "OK MIX {\"pass\":%s,\"frames\":%u,\"fpga_tx\":%u,\"elapsed_ms\":%lld,"
        "\"crc_errors\":%u,\"discarded\":%u,\"trailing\":%u,\"sequence_errors\":%u,"
        "\"flag_errors\":%u,\"value_errors\":%u,\"dma_errors\":%ld,\"overruns\":%u,"
        "\"spi_errors\":%u,\"error\":%d,\"cleanup_error\":%d,\"control_error\":%s,"
        "\"source_drop\":%u,\"missed\":%u,\"frame_drop\":%u,\"sequence\":%u,\"flags\":%u,\"adc24\":[",
        ok ? "true" : "false", stats.frames, tx, (long long)elapsed, stats.crc_errors,
        stats.discarded, (unsigned)stats.used, stats.sequence_errors, stats.flag_errors,
        stats.value_errors, (long)atomic_get(&dma_errors), overrun, spi_errors, rc, cleanup,
        ctrl.error[0] ? "true" : "false", diagnostics[0], diagnostics[1], diagnostics[2],
        stats.last.sequence, stats.last.flags);
    for (unsigned i = 0; i < 3; ++i) {
        used += snprintf(reply + used, SPI4_REPLY_SIZE - used,
            "%s{\"raw\":%u,\"seq\":%u,\"age_us\":%u,\"known\":%u,\"fresh\":%u,\"stale\":%u,\"max_age_us\":%u,\"restart\":%u,\"replaced\":%u}",
            i ? "," : "", stats.last.adc24_raw[i], stats.last.adc24_sequence[i],
            stats.last.adc24_age_us[i], stats.known[i], stats.fresh[i], stats.stale[i], stats.max_age[i], restarts[i], replaced[i]);
    }
    used += snprintf(reply + used, SPI4_REPLY_SIZE - used, "],\"adc16\":[");
    for (unsigned i = 0; i < 8; ++i) {
        used += snprintf(reply + used, SPI4_REPLY_SIZE - used,
            "%s{\"raw\":%u,\"min\":%d,\"max\":%d}", i ? "," : "",
            stats.last.adc16[i], stats.minimum[i], stats.maximum[i]);
    }
    snprintf(reply + used, SPI4_REPLY_SIZE - used, "]}\n");
    return true;
syntax:
    strcpy(reply, "ERR COMMAND MIXCAP ms(100..3000) dummy(0|1) required24_mask max_age_us raw1 raw2 raw3\n");
    return true;
}
```

## src/mixed_adc_test.h
```c
/* SPDX-License-Identifier: Apache-2.0 */
#ifndef REV58_MIXED_ADC_TEST_H
#define REV58_MIXED_ADC_TEST_H
#include "spi4_protocol.h"
bool mixed_adc_command(char *line, char reply[SPI4_REPLY_SIZE],
                       spi4_transfer_fn transfer, void *context);
#endif
```

## src/peripheral_checks.c
```c
/* SPDX-License-Identifier: Apache-2.0 */
#include <zephyr/kernel.h>
#include <zephyr/device.h>
#include <zephyr/devicetree.h>
#include <zephyr/sys/printk.h>
#include "peripheral_checks.h"

#if DT_NODE_HAS_STATUS(DT_NODELABEL(sdram), okay)
BUILD_ASSERT(!IS_ENABLED(CONFIG_DCACHE), "SDRAM bring-up must access physical memory");
BUILD_ASSERT(DT_REG_ADDR(DT_NODELABEL(sdram2)) == 0xd0000000, "BANK2 address");
BUILD_ASSERT(DT_REG_SIZE(DT_NODELABEL(sdram2)) == 0x00800000, "8 MiB capacity");
struct memory_test_status {
    unsigned int stage; /* 1=data bus, 2=address, 3=inverse/retention, 4=byte lanes, 5=pass */
    uintptr_t failed_address;
    uint32_t expected;
    uint32_t actual;
};
volatile struct memory_test_status rev58_memtest;

static int mismatch(uintptr_t address, uint32_t expected, uint32_t actual)
{
    rev58_memtest.failed_address = address;
    rev58_memtest.expected = expected;
    rev58_memtest.actual = actual;
    printk("SDRAM FAIL stage=%u address=0x%08lx expected=%08x actual=%08x\n",
           rev58_memtest.stage, (unsigned long)address, expected, actual);
    return -EIO;
}

static int check_sdram(void)
{
    if (!device_is_ready(DEVICE_DT_GET(DT_NODELABEL(sdram)))) {
        return -ENODEV;
    }
    volatile uint32_t *words = (void *)DT_REG_ADDR(DT_NODELABEL(sdram2));
    const size_t count = DT_REG_SIZE(DT_NODELABEL(sdram2)) / sizeof(*words);
    rev58_memtest.stage = 1;
    for (unsigned int bit = 0; bit < 32; ++bit) {
        for (unsigned int inverse = 0; inverse < 2; ++inverse) {
            uint32_t expected = inverse ? ~BIT(bit) : BIT(bit);
            words[0] = expected;
            uint32_t actual = words[0];
            if (actual != expected) {
                return mismatch((uintptr_t)words, expected, actual);
            }
        }
    }
    /* Separate whole-memory write/read passes detect address aliasing. */
    for (unsigned int inverse = 0; inverse < 2; ++inverse) {
        rev58_memtest.stage = inverse ? 3 : 2;
        for (size_t i = 0; i < count; ++i) {
            uint32_t expected = (uint32_t)(uintptr_t)&words[i];
            words[i] = inverse ? ~expected : expected;
        }
        if (inverse) {
            k_sleep(K_SECONDS(1)); /* Refresh/retention smoke test only. */
        }
        for (size_t i = 0; i < count; ++i) {
            uint32_t expected = (uint32_t)(uintptr_t)&words[i];
            expected = inverse ? ~expected : expected;
            uint32_t actual = words[i];
            if (actual != expected) {
                return mismatch((uintptr_t)&words[i], expected, actual);
            }
        }
    }
    rev58_memtest.stage = 4;
    volatile uint16_t *halves = (void *)words;
    volatile uint8_t *bytes = (void *)words;
    for (size_t i = 0; i < count * 2; ++i) {
        halves[i] = 0xa55a;
        bytes[2 * i] = 0x3c;
        uint16_t actual = halves[i];
        if (actual != 0xa53c) {
            return mismatch((uintptr_t)&halves[i], 0xa53c, actual);
        }
        bytes[2 * i + 1] = 0xc3;
        actual = halves[i];
        if (actual != 0xc33c) {
            return mismatch((uintptr_t)&halves[i], 0xc33c, actual);
        }
    }
    rev58_memtest.stage = 5;
    printk("SDRAM smoke test PASS: 8 MiB address/inverse/byte lanes; 1 s retention\n");
    return 0;
}
#endif

#if DT_NODE_HAS_STATUS(DT_NODELABEL(mac), okay)
#include <zephyr/net/phy.h>
#include <zephyr/net/mii.h>
static const struct device *const phy = DEVICE_DT_GET(DT_NODELABEL(eth_phy));
static int check_ethernet(void)
{
    if (!device_is_ready(phy) || !device_is_ready(DEVICE_DT_GET(DT_NODELABEL(mac)))) {
        return -ENODEV;
    }
    uint32_t id1, id2;
    int ret = phy_read(phy, MII_PHYID1R, &id1);
    if (ret == 0) {
        ret = phy_read(phy, MII_PHYID2R, &id2);
    }
    if (ret != 0) {
        return ret;
    }
    printk("PHY address 0: ID1=%04x ID2=%04x (compare with assembled LAN8742A)\n", id1, id2);
    return 0;
}
#endif

int rev58_peripheral_checks(void)
{
#if DT_NODE_HAS_STATUS(DT_NODELABEL(sdram), okay)
    {
        int err = check_sdram();
        if (err) { return err; }
    }
#endif
#if DT_NODE_HAS_STATUS(DT_NODELABEL(mac), okay)
    {
        int err = check_ethernet();
        if (err) { return err; }
    }
#endif
#if DT_NODE_HAS_STATUS(DT_NODELABEL(spi1), okay)
    const struct device *const buses[] = {
        DEVICE_DT_GET(DT_NODELABEL(spi1)),
#if DT_NODE_HAS_STATUS(DT_NODELABEL(spi2), okay)
        DEVICE_DT_GET(DT_NODELABEL(spi2)),
#endif
#if DT_NODE_HAS_STATUS(DT_NODELABEL(spi3), okay)
        DEVICE_DT_GET(DT_NODELABEL(spi3)),
#endif
#if DT_NODE_HAS_STATUS(DT_NODELABEL(spi4), okay)
        DEVICE_DT_GET(DT_NODELABEL(spi4)),
#endif
    };
    for (size_t i = 0; i < ARRAY_SIZE(buses); ++i) {
        if (!device_is_ready(buses[i])) { return -ENODEV; }
    }
    printk("Enabled SPI drivers ready\n");
#endif
    return 0;
}

void rev58_peripheral_poll(void)
{
#if DT_NODE_HAS_STATUS(DT_NODELABEL(mac), okay)
    struct phy_link_state state;
    int err = phy_get_link_state(phy, &state);
    if (err) {
        printk("PHY link read failed: %d\n", err);
    } else {
        printk("PHY link=%s speed_flags=0x%x\n", state.is_up ? "up" : "down", state.speed);
    }
#endif
}
```

## src/peripheral_checks.h
```c
/* SPDX-License-Identifier: Apache-2.0 */
#ifndef REV58_PERIPHERAL_CHECKS_H
#define REV58_PERIPHERAL_CHECKS_H
int rev58_peripheral_checks(void);
void rev58_peripheral_poll(void);
#endif
```

## src/spi4_test_server.h
```c
/* SPDX-License-Identifier: Apache-2.0 */
#ifndef JPARC_SPI4_TEST_SERVER_H
#define JPARC_SPI4_TEST_SERVER_H
int spi4_test_server_start(void);
#endif
```
