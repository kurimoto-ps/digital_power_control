## targets/jparc_rev58/boards/jparc/jparc_rev58/Kconfig.jparc_rev58
```kconfig
# SPDX-License-Identifier: Apache-2.0
config BOARD_JPARC_REV58
    select SOC_STM32H745XX_M7
```

## targets/jparc_rev58/boards/jparc/jparc_rev58/board.yml
```yaml
board:
  name: jparc_rev58
  full_name: J-PARC rev58 STM32H745XI
  vendor: others
  socs:
    - name: stm32h745xx
```

## targets/jparc_rev58/dts/bindings/spi/altr,max10-spi4-regs.yaml
```yaml
description: J-PARC MAX10 SPI4 register test interface v1
compatible: "altr,max10-spi4-regs"
include: spi-device.yaml
```

## west.yml
```yaml
manifest:
  remotes:
    - name: zephyrproject
      url-base: https://github.com/zephyrproject-rtos

  projects:
    - name: zephyr
      remote: zephyrproject
      revision: d9c3a39174fdc96b5177faa41c62b056c224512b
      path: zephyr
      import: true

  self:
    path: digital_power_control
```
